## remotemanager_server/system/rootfs/buildroot-2014.02/package/nginx/Config.in
```kconfig
config BR2_PACKAGE_NGINX
	bool "nginx"
	help
	  Nginx is an open source reverse proxy server for HTTP, HTTPS,
	  SMTP, POP3, and IMAP protocols, as well as a load balancer,
	  HTTP cache, and a web server (origin server) with a strong focus on,
	  high concurrency, high performance and low memory usage.

	  http://nginx.org/

if BR2_PACKAGE_NGINX

config BR2_PACKAGE_NGINX_OPENSSL
	bool "openssl support"
	select BR2_PACKAGE_OPENSSL
	help
	  Enable OpenSSL support for nginx.

config BR2_PACKAGE_NGINX_ZLIB
	bool "zlib support"
	select BR2_PACKAGE_ZLIB
	help
	  Enable zlib support for nginx mod_compress.

endif
```

## remotemanager_server/system/rootfs/buildroot-2014.02/package/postgresql/Config.in
```kconfig
config BR2_PACKAGE_POSTGRESQL
	bool "PostgreSQL"
	depends on BR2_INET_IPV6
	select BR2_PACKAGE_READLINE
	select BR2_PACKAGE_ZLIB
	help
	  PostgreSQL is a powerful, open source object-relational
	  database system.

	  Enable the readline package to gain readline support in
	  pgsql (the command line interpreter), which offers
	  command history and edit functions.

	  Enable the zlib package to gain builtin compression for
	  archives with pg_dump and pg_restore.

	  http://www.postgresql.org

comment "PostgreSQL needs a toolchain w/ IPv6"
	depends on !BR2_INET_IPV6
```

## remotemanager_server/system/rootfs/buildroot-2014.02/package/python-pip/Config.in
```kconfig
config BR2_PACKAGE_PYTHON_PIP
	bool "python-pip"
	select BR2_HOST_PYTHON_SSL_SUPPORT
	help
	  A tool for installing and managing Python packages.

	  http://www.pip-installer.org

config BR2_PACKAGE_PYTHON_PIP_MODULES_ADDITIONAL
	string "Additional modules"
	help
	  List of space-separated python modules to install via pip.
	  See 'pip help install' for available installation methods. 
	  For repeatable builds, download and save tgz files or clone 
	  git repos for the components you care about.

	  Example: module-name module-name==1.3.4 /my/module/mymodule.tgz 
	  git://github.com/someuser/somemodule.git#v1.2
```

## remotemanager_server/system/rootfs/buildroot-2014.02/package/remotemanager/Config.in
```kconfig
config BR2_PACKAGE_REMOTEMANAGER
	bool "remotemanager"
	depends on BR2_PACKAGE_PYTHON
	help
	  Remote management web service.

if BR2_PACKAGE_REMOTEMANAGER

config BR2_PACKAGE_REMOTEMANAGER_ETHERNET_INTERFACE
	bool "eth0 interface handler"
	help
	  Monitor the state of the ethernet link and call ifup/ifdown when the link goes up/down

config BR2_PACKAGE_REMOTEMANAGER_RFCOMM_WATCHDOG
	bool "rfcomm watchdog"
	help
	  Reboot the system if an rfcomm interface gets locked
endif
```
